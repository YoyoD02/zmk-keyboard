## config/west.yml
```yaml
manifest:
  defaults:
    revision: v0.3
  remotes:
    - name: zmkfirmware
      url-base: https://github.com/zmkfirmware
    # Additional modules containing boards/shields/custom code can be listed here as well
    # See https://docs.zephyrproject.org/3.2.0/develop/west/manifest.html#projects

    - name: yoyod02   # 替换为你的GitHub用户名
      url-base: https://github.com/YoyoD02

  projects:
    - name: zmk
      remote: zmkfirmware
      import: app/west.yml

    - name: zmk-keyboard       # 你的新灯效模块名称
      remote: yoyod02
      revision: main
      path: zmk-keyboard   # 告诉 west 模块在仓库中的子路径

  self:
    path: config
```

## config/zmk-vfx-keypress/Kconfig
```kconfig
mainmenu "ZMK Keypress Effect Configuration"
config ZMK_VFX_KEYPRESS
    bool "ZMK Keypress Visual Effect"
    default y
    help
      Enable the keypress visual effect module.
```

## modules/zmk-module-typing-follow/Kconfig
```kconfig
# modules/zmk-module-typing-follow/Kconfig
# 模块的Kconfig配置，用于启用/禁用功能

menuconfig ZMK_BEHAVIOR_TYPING_FOLLOW
    bool "Typing Follow Effect"
    depends on ZMK_RGB_UNDERGLOW
    select ZMK_RGB_UNDERGLOW_EXT_POWER
    help
      Enable typing follow lighting effect.
      When a key is pressed, LEDs light up and then fade out.
      
      启用打字跟随灯效：按键时LED亮起并逐渐熄灭。

if ZMK_BEHAVIOR_TYPING_FOLLOW

config ZMK_TYPING_FOLLOW_FADE_DURATION_MS
    int "Fade duration in milliseconds"
    default 300
    range 100 2000
    help
      Duration of the fade-out effect in milliseconds.
      淡出效果的持续时间（毫秒）。

config ZMK_TYPING_FOLLOW_MAX_BRIGHTNESS
    int "Maximum brightness percentage"
    default 100
    range 0 100
    help
      Peak brightness when key is pressed.
      按键时的峰值亮度百分比。

config ZMK_TYPING_FOLLOW_FADE_STEPS
    int "Number of fade steps"
    default 10
    range 5 30
    help
      Number of steps for smooth fade-out animation.
      淡出动画的步数，越多越平滑。

endif
```

## modules/zmk-module-typing-follow/dts/bindings/zmk,behavior-typing-follow.yaml
```yaml
# modules/zmk-module-typing-follow/dts/bindings/zmk,behavior-typing-follow.yaml
# Devicetree绑定定义，声明行为节点的属性

description: Typing Follow LED Effect Behavior

compatible: "zmk,behavior-typing-follow"

include: [ "zero_param.yaml" ]

properties:
  "#binding-cells":
    const: 0

  label:
    required: true
    type: string
    description: Human readable label for the behavior

  fade-duration-ms:
    type: int
    default: 300
    description: Fade-out duration in milliseconds

  max-brightness:
    type: int
    default: 100
    description: Peak brightness percentage (0-100)
```
